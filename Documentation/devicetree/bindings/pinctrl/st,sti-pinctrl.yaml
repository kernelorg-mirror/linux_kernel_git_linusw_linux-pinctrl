## Documentation/devicetree/bindings/pinctrl/st,sti-pinctrl.yaml
```yaml
# SPDX-License-Identifier: (GPL-2.0 OR BSD-2-Clause)
%YAML 1.2
---
$id: http://devicetree.org/schemas/pinctrl/st,sti-pinctrl.yaml#
$schema: http://devicetree.org/meta-schemas/core.yaml#

title: ST STi/GLLCFF GPIO and Pin Mux/Config controller

maintainers:
  - Linus Walleij <linus.walleij@linaro.org>

description: |
  In the ST STi/GLLCFF pin controller each multi-function pin is controlled,
  driven and routed through the PIO multiplexing block. Each pin supports
  GPIO functionality (ALT0) and multiple alternate functions(ALT1 - ALTx)
  that directly connect the pin to different hardware blocks.

  The STi SoCs are used for consumer electronics. The GLLCFF SoCs are
  used for SpaceX Starlink.

  When a pin is in GPIO mode, Output Enable (OE), Open Drain(OD), and
  Pull Up (PU) are driven by the related PIO block.

  ST pinctrl driver controls PIO multiplexing block and also interacts with
  gpio driver to configure a pin.

  GPIO bank can have one of the two possible types of interrupt-wirings.

  First type is via irqmux, single interrupt is used by multiple gpio banks. This
  reduces number of overall interrupts numbers required. All these banks belong to
  a single pincontroller.
                  _________
                 |         |----> [gpio-bank (n)    ]
                 |         |----> [gpio-bank (n + 1)]
        [irqN]-- | irq-mux |----> [gpio-bank (n + 2)]
                 |         |----> [gpio-bank (...  )]
                 |_________|----> [gpio-bank (n + 7)]

  Second type has a dedicated interrupt per gpio bank.

        [irqN]----> [gpio-bank (n)]

properties:
  compatible:
    enum:
      - st,gllcff-pinctrl
      - st,gllcff-flash-pinctrl
      - st,stih407-front-pinctrl
      - st,stih407-rear-pinctrl
      - st,stih407-flash-pinctrl
      - st,stih407-sbc-pinctrl

  '#address-cells':
    const: 1

  '#size-cells':
    const: 1

  reg: true

  reg-names:
    const: irqmux

  ranges: true

  interrupts:
    maxItems: 1

  interrupt-names:
    const: irqmux

  st,syscfg:
    description: Should be a phandle of the syscfg node
    $ref: /schemas/types.yaml#/definitions/phandle-array
    items:
      - items:
          - description: syscon node to be used with the pin controller

patternProperties:
  # GPIO banks below the main node
  '^(gpio|pio)@[0-9a-f]+$':
    type: object
    additionalProperties: false

    properties:
      gpio-controller: true

      '#gpio-cells':
        const: 2

      interrupt-controller: true

      '#interrupt-cells':
        const: 2

      reg:
        maxItems: 1

      resets:
        maxItems: 1

      gpio-line-names: true

      st,bank-name:
        description:
          Should be a name string for this bank as specified in the datasheet.
        $ref: /schemas/types.yaml#/definitions/string
        enum:
          - PIO0
          - PIO1
          - PIO2
          - PIO3
          - PIO4
          - PIO5
          - PIO10
          - PIO11
          - PIO12
          - PIO13
          - PIO14
          - PIO15
          - PIO16
          - PIO17
          - PIO18
          - PIO19
          - PIO20
          - PIO30
          - PIO31
          - PIO32
          - PIO33
          - PIO34
          - PIO35
          - PIO40
          - PIO41
          - PIO42

      st,retime-pin-mask:
        description:
          Should be mask to specify which pins can be retimed.
          If the property is not present, it is assumed that all the pins in the
          bank are capable of retiming. Retiming is mainly used to improve the
          IO timing margins of external synchronous interfaces.
        $ref: /schemas/types.yaml#/definitions/uint32
        minimum: 0
        maximum: 63

    patternProperties:
      "^(.+-hog(-[0-9]+)?)$":
        type: object
        required:
          - gpio-hog

    required:
      - gpio-controller
      - '#gpio-cells'
      - reg
      - st,bank-name

  # Explicitly match all other nodes, EXCEPT the gpio nodes
  # these contain the actual pin control states
  '^(cec|rc|sbc_serial|i2c|keyscan|gmac|pwm|spi|serial|mmc|tsin|tsout|mtsin|systrace|usb|i2s_out|i2s_in|spdif_out|fsm|nand)[0-9]*$':
    type: object
    additionalProperties: false

    patternProperties:
      '[-_0-9a-z]+$':
        type: object
        additionalProperties: false

        patternProperties:
          '^st,pins':
            type: object
            additionalProperties: false
            description: The st,pins is a custom key equals value list. The value
              is a phandle with 4 or 7 parameters.

            patternProperties:
              ^[-_0-9a-zA-Z]+$:
                description: the parameters to the phandle configures the pin.
                   Arg 0 = pio node phandle for the bank of the pin
                   Arg 1 = pin offset for the pin in the pio unit
                   Arg 2 = mux alternate function taken from the datasheet
                   Arg 3 = pin configuration mode for the pin, bits for a register
                   Arg 5 = retiming configuration for the pin
                   Arg 6 = retiming delay in picoseconds
                   Arg 7 = retiming clock to be used for the delay
                $ref: /schemas/types.yaml#/definitions/phandle-array
                minItems: 1
                maxItems: 1
                items:
                  minItems: 4
                  maxItems: 7

allOf:
  - $ref: pinctrl.yaml#

required:
  - compatible
  - '#address-cells'
  - '#size-cells'
  - reg
  - reg-names
  - ranges

additionalProperties: false

examples:
  - |
    #include <dt-bindings/interrupt-controller/arm-gic.h>
    pinctrl@961f080 {
      compatible = "st,stih407-sbc-pinctrl";
      #address-cells = <1>;
      #size-cells = <1>;
      st,syscfg = <&syscfg_sbc>;
      reg = <0x0961f080 0x4>;
      reg-names = "irqmux";
      interrupts = <GIC_SPI 188 IRQ_TYPE_LEVEL_HIGH>;
      interrupt-names = "irqmux";
      ranges = <0 0x09610000 0x6000>;

      pio0: gpio@9610000 {
        gpio-controller;
        #gpio-cells = <2>;
        interrupt-controller;
        #interrupt-cells = <2>;
        reg = <0x0 0x100>;
        st,bank-name = "PIO0";
      };

      sbc_serial0 {
        pinctrl_sbc_serial0: sbc_serial0-0 {
          st,pins {
            tx = <&pio0 4 1 (1 << 27)>;
            rx = <&pio0 5 1 0>;
          };
        };
      };
    };
...
```
